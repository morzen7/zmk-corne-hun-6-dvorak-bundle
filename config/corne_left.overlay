/*
 * TEMPORARY: routes USB logging (enabled via cmake-args on this build only)
 * to the studio-rpc-usb-uart snippet's CDC-ACM UART, so we can see the raw
 * row/col -> position resolution happening locally on this board (which
 * runs regardless of split role, before anything goes out over BLE).
 * Remove once the row2 position-shift issue is diagnosed.
 */

/ {
    chosen {
        zephyr,console = &snippet_studio_rpc_usb_uart;
    };
};
